## FTS1BA90A/Kconfig
```kconfig
config TOUCHSCREEN_STM_FTS1BA90A
    tristate "STMicroelectronics FTS1BA90A touchscreen"
    depends on I2C
    help
      Say Y here if you want support for the STMicroelectronics
      FTS1BA90A touchscreen.
      Warning: This driver is extremely experimental.
```
